## conf/layer.conf
```bitbake
# We have a conf and classes directory, add to BBPATH
BBPATH .= ":${LAYERDIR}"

# We have recipes-* directories, add to BBFILES
BBFILES += "${LAYERDIR}/recipes-*/*/*.bb \
            ${LAYERDIR}/recipes-*/*/*.bbappend"

BBFILE_COLLECTIONS += "meta-printing"
BBFILE_PATTERN_meta-printing = "^${LAYERDIR}/"
BBFILE_PRIORITY_meta-printing = "6"

LAYERSERIES_COMPAT_meta-printing = "warrior"
```
